// RavensPi, 2025-2026
// External Module/File: RefillStation.ino

// Code for the refill station
// Runs on Arduino UNO R4 WiFi

#define relayPin 6
#define switchPin 9
#define waterSensorPin A0

#include <Wire.h>
#include <Adafruit_GFX.h>
#include <SparkFun_Qwiic_OLED.h>

#include <res/qw_fnt_5x7.h>
#include <res/qw_fnt_8x16.h>

int width;
int height;

int xdisp0;
int ydisp0;

int value = 0;

QwiicNarrowOLED myOLED; 

// RavensPi Logo, 128x32px
uint8_t Ravens_Pi_Icon[] PROGMEM = {
  0x00, 0x00, 0x00, 0x00, 0x00, 0x00, 0x00, 0x00, 0x00, 0x00, 0x00, 0x00, 0x00, 0x00, 0x00, 0x00,
  0x00, 0x00, 0x00, 0x00, 0x00, 0x00, 0x00, 0x00, 0x00, 0x00, 0x00, 0x00, 0x00, 0x00, 0x00, 0x00,
  0x00, 0x00, 0x00, 0x00, 0x00, 0x00, 0x00, 0x00, 0x00, 0x00, 0x00, 0x00, 0x00, 0x00, 0x00, 0x00,
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  0x00, 0x00, 0x00, 0x00, 0x00, 0x00, 0x00, 0x00, 0x00, 0x00, 0x00, 0x00, 0x00, 0x00, 0x00, 0x00
};


void setup() {
  pinMode(relayPin, OUTPUT);
  pinMode(switchPin, INPUT_PULLUP);
  digitalWrite(relayPin, LOW);

  Serial.begin(9600);

  Wire1.begin();

  if (myOLED.begin(Wire1) == false) {
    Serial.println("Device begin failed. Freezing...");
    while (true)
      ;
  }
  Serial.println("Begin success");

  width = myOLED.getWidth();
  height = myOLED.getHeight();

  myOLED.reset(true);
  myOLED.erase();
  myOLED.bitmap(0, 0, Ravens_Pi_Icon, 128, 32);
  myOLED.display();

  delay(3000);

  myOLED.erase();
  myOLED.display();
  displayText("Ready.");

  delay(1000);
}

void loop() {
  int switchState = digitalRead(switchPin);

  if (digitalRead(switchPin) == LOW) {
    Serial.println("Switch held!");
    displayText("Robot Detected");

    int waterLevel = analogRead(waterSensorPin);
    Serial.print("Water sensor: ");
    Serial.println(waterLevel);

    if (waterLevel < 200) {
      Serial.println("Refill station, it is low on water");
      for (int i = 0; i < 5; i++) {
        displayText("Station low");
        delay(1000);
        displayText("Refill station");
        delay(1000);
      }
      displayText("Ready.");
    } else {
      pourWater();
      displayText("Ready.");
    }

    while (digitalRead(switchPin) == LOW) {
      delay(50);
    }
  }

  delay(50);  // small debounce
}

// Pour about 1 cup of water
void pourWater() {
  displayText("Pouring Water");
  digitalWrite(relayPin, HIGH);
  delay(10500);
  digitalWrite(relayPin, LOW);
  displayText("Completed");
}

// Display text that is centered
void displayText(const char* text) {

  myOLED.erase();

  myOLED.setFont(QW_FONT_8X16);

  xdisp0 = (myOLED.getWidth() - myOLED.getStringWidth(text)) / 2;

  // starting y position - screen height minus string height / 2
  ydisp0 = (myOLED.getHeight() - myOLED.getStringHeight(text)) / 2;

  myOLED.text(xdisp0, ydisp0, text, 1);

  myOLED.display();
}
